## configs/router-T113_defconfig
```kconfig
CONFIG_ARM=y
CONFIG_ARCH_SUNXI=y
CONFIG_SERIAL_TAG=y
CONFIG_ENV_SIZE=0x20000
CONFIG_ENV_OFFSET=0x0
CONFIG_DEFAULT_DEVICE_TREE="sun8i-t113s-router"
CONFIG_SYS_LOAD_ADDR=0x42A00000
CONFIG_SPL=y
CONFIG_DRAM_SUNXI_ODT_EN=0
CONFIG_DRAM_SUNXI_TPR0=0x004a2195
CONFIG_DRAM_SUNXI_TPR11=0x340000
CONFIG_DRAM_SUNXI_TPR12=0x46
CONFIG_MACH_SUN8I_R528=y
CONFIG_MACH_SUN8I_T113=y
CONFIG_DRAM_CLK=792
CONFIG_DRAM_ZQ=8092667
CONFIG_SUNXI_MINIMUM_DRAM_MB=128
CONFIG_UART0_PORT_F=y
CONFIG_SPL_SPI_SUNXI=y
CONFIG_SPL_SPI_SUNXI_NAND=y
CONFIG_SPL_SPI_SUNXI_NAND_ASSUMED_PAGESIZE=0x800
CONFIG_ENV_VARS_UBOOT_CONFIG=y
# CONFIG_SYS_MALLOC_CLEAR_ON_INIT is not set
# CONFIG_EFI_LOADER is not set
CONFIG_TIMESTAMP=y
# CONFIG_BOOTSTD_BOOTCOMMAND is not set
# CONFIG_DISTRO_DEFAULTS is not set
CONFIG_NAND_BOOT=y
CONFIG_QSPI_BOOT=y
CONFIG_SPI_BOOT=y
CONFIG_SPL_SILENT_CONSOLE=y
# CONFIG_SYS_DEVICE_NULLDEV is not set
# CONFIG_SPL_RAW_IMAGE_SUPPORT is not set
# CONFIG_SPL_BANNER_PRINT is not set
# CONFIG_SPL_POWER is not set
# CONFIG_CMD_BOOTFLOW is not set
CONFIG_CMD_BOOTZ=y
# CONFIG_BOOTM_NETBSD is not set
# CONFIG_BOOTM_PLAN9 is not set
# CONFIG_BOOTM_RTEMS is not set
# CONFIG_BOOTM_VXWORKS is not set
# CONFIG_CMD_ELF is not set
# CONFIG_CMD_FDT is not set
CONFIG_CMD_LZMADEC=y
CONFIG_CMD_DFU=y
# CONFIG_CMD_GPT is not set
# CONFIG_CMD_LOADS is not set
CONFIG_CMD_MTD=y
# CONFIG_CMD_SF is not set
CONFIG_CMD_WDT=y
# CONFIG_CMD_DATE is not set
CONFIG_CMD_MTDPARTS=y
CONFIG_CMD_UBI=y
# CONFIG_ENV_IS_IN_SPI_FLASH is not set
CONFIG_ENV_IS_IN_MTD=y
CONFIG_ENV_MTD_DEV="u-boot-env"
CONFIG_NO_NET=y
CONFIG_DFU_MTD=y
CONFIG_DMA=y
CONFIG_DMA_CHANNELS=y
CONFIG_DMA_LEGACY=y
CONFIG_SYS_I2C_SUN6I_P2WI=y
CONFIG_SYS_I2C_SUN8I_RSB=y
# CONFIG_INPUT is not set
CONFIG_LED=y
CONFIG_LED_BOOT=y
CONFIG_LED_ACTIVITY=y
CONFIG_LED_PWM=y
CONFIG_LED_BLINK=y
CONFIG_LED_SW_BLINK=y
CONFIG_LED_GPIO=y
# CONFIG_MMC is not set
CONFIG_MTD=y
CONFIG_DM_MTD=y
CONFIG_MTD_CONCAT=y
CONFIG_MTD_BLOCK=y
# CONFIG_MTD_RAW_NAND is not set
CONFIG_MTD_SPI_NAND=y
# CONFIG_SPI_FLASH is not set
CONFIG_UBI_BLOCK=y
CONFIG_DM_PWM=y
CONFIG_PWM_SUNXI=y
CONFIG_DRAM_SUNXI_TPR13=0x34000100
CONFIG_DM_RTC=y
CONFIG_SPI=y
CONFIG_DM_USB_GADGET=y
CONFIG_USB_GADGET_DOWNLOAD=y
CONFIG_WATCHDOG_AUTOSTART=y
# CONFIG_BINMAN_FDT is not set
# CONFIG_VPL_LZMA is not set
```
